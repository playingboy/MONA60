## boards/arm/mona60/Kconfig.defconfig
```kconfig
# Copyright (c) 2021 The ZMK Contributors
# SPDX-License-Identifier: MIT

if BOARD_MONA60

config BOARD
    default "mona60"


if ZMK_DISPLAY

config I2C
    default y

config SSD1306
    default y

endif # ZMK_DISPLAY

if LVGL

config LV_Z_VDB_SIZE
    default 64

config LV_DPI_DEF
    default 148

config LV_Z_BITS_PER_PIXEL
    default 1

choice LV_COLOR_DEPTH
    default LV_COLOR_DEPTH_1
endchoice

endif # LVGL

if USB_DEVICE_STACK

config USB_NRFX
    default y

endif # USB_DEVICE_STACK

config BT_CTLR
    default BT

endif #
```

## boards/arm/mona60/board.yml
```yaml
board:
  name: mona60
  vendor: monakeyboards
  socs:
    - name: nrf52840
      variants:
        - name: zmk
```

## boards/shields/mona60/Kconfig.shield
```kconfig
# No whitespace after the comma or in the keyboard name!
config BOARD_MONA60_DONGLE
    def_bool $(shields_list_contains,mona60_dongle)
```

## boards/shields/nhkb/Kconfig.defconfig
```kconfig
if SHIELD_NHKB

# Name must be less than 16 characters long!
config ZMK_KEYBOARD_NAME
    default "NHKB"

endif
```
